/dts-v1/;
/plugin/;

/ {
    compatible = "ti,beaglebone", "ti,beaglebone-black";
    part-number = "BB-PRU0-AD7606";
    version = "00A0";

    fragment@0 {
        target = <&am33xx_pinmux>;
        __overlay__ {
            pinmux_pru0_ad7606_pins: pinmux_pru0_ad7606_pins {
                pinctrl-single,pins = <
                    /* CONVST (P9.31) PRU0_R30_0 */
                    0x190 0x05 
                    /* BUSY (P9.29) PRU0_R31_0 */
                    0x194 0x26 
                    /* D0-D7 (P9.27, 25, 28, 30, 92, 42, 91, 41) */
                    0x1a4 0x26 0x1ac 0x26 0x19c 0x26 0x198 0x26
                    0x1a0 0x26 0x164 0x26 0x1a8 0x26 0x1b4 0x26
                    /* D8-D15 (P8.45, 46, 43, 44, 41, 42, 39, 40) */
                    0x0a0 0x26 0x0a4 0x26 0x0a8 0x26 0x0ac 0x26
                    0x0b0 0x26 0x0b4 0x26 0x0b8 0x26 0x0bc 0x26
                >;
            };
        };
    };

    fragment@1 {
        target = <&pruss>;
        __overlay__ {
            status = "okay";
            pinctrl-names = "default";
            pinctrl-0 = <&pinmux_pru0_ad7606_pins>;
        };
    };
};
